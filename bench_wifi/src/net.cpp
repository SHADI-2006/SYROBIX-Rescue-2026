#include "net.h"

#include <Arduino.h>
#include <WiFi.h>
#include <WebServer.h>
#include <WebSocketsServer.h>
#include <string.h>

#include "wifi_config.h"
#include "index_html.h"   // generated by tools/embed_html.py

namespace {

WebServer        g_http(WIFI_HTTP_PORT);
WebSocketsServer g_ws(WIFI_WS_PORT);
NetTextHandler   g_onText = nullptr;
NetEventHandler  g_onGone = nullptr;
char             g_ip[16] = "0.0.0.0";
bool             g_sta    = false;
char             g_cmd[160];

void serveIndex() {
    g_http.sendHeader("Content-Encoding", "gzip");
    g_http.sendHeader("Cache-Control", "no-store");
    g_http.send_P(200, "text/html; charset=utf-8",
                  reinterpret_cast<const char*>(INDEX_HTML_GZ), INDEX_HTML_GZ_LEN);
}

void wsEvent(uint8_t num, WStype_t type, uint8_t* payload, size_t len) {
    (void)num;
    if (type == WStype_TEXT) {
        if (!g_onText) return;
        // A frame may carry several lines; split on '\n'.
        size_t start = 0;
        for (size_t i = 0; i <= len; ++i) {
            if (i == len || payload[i] == '\n' || payload[i] == '\r') {
                size_t n = i - start;
                if (n > 0) {
                    if (n >= sizeof(g_cmd)) n = sizeof(g_cmd) - 1;
                    memcpy(g_cmd, payload + start, n);
                    g_cmd[n] = '\0';
                    g_onText(g_cmd);
                }
                start = i + 1;
            }
        }
    } else if (type == WStype_DISCONNECTED) {
        if (g_ws.connectedClients() == 0 && g_onGone) g_onGone();
    }
}

}  // namespace

void netBegin(NetTextHandler onText, NetEventHandler onAllClientsGone) {
    g_onText = onText;
    g_onGone = onAllClientsGone;

    WiFi.persistent(false);
    g_sta = false;
    if (strlen(WIFI_STA_SSID) > 0) {
        WiFi.mode(WIFI_STA);
        WiFi.begin(WIFI_STA_SSID, WIFI_STA_PASS);
        const uint32_t t0 = millis();
        while (WiFi.status() != WL_CONNECTED && millis() - t0 < WIFI_STA_TIMEOUT_MS) {
            delay(100);   // boot-time only
        }
        g_sta = (WiFi.status() == WL_CONNECTED);
    }
    if (!g_sta) {
        WiFi.mode(WIFI_AP);
        WiFi.softAP(WIFI_AP_SSID, WIFI_AP_PASS, WIFI_AP_CHANNEL, 0, 2);
        strncpy(g_ip, WiFi.softAPIP().toString().c_str(), sizeof(g_ip) - 1);
    } else {
        strncpy(g_ip, WiFi.localIP().toString().c_str(), sizeof(g_ip) - 1);
    }
    WiFi.setTxPower(WIFI_TX_POWER);
    WiFi.setSleep(false);   // modem sleep adds 100+ ms latency spikes -> deadman trips

    g_http.on("/", serveIndex);
    g_http.on("/index.html", serveIndex);
    g_http.onNotFound([]() {
        g_http.sendHeader("Location", "/");
        g_http.send(302, "text/plain", "");
    });
    g_http.begin();

    g_ws.begin();
    g_ws.onEvent(wsEvent);
    g_ws.enableHeartbeat(1000, 1000, 2);   // drop dead clients within ~3 s
}

void netService() {
    g_http.handleClient();
    g_ws.loop();
}

void netSend(const char* data, size_t len) {
    if (g_ws.connectedClients() == 0) return;
    g_ws.broadcastTXT(reinterpret_cast<const uint8_t*>(data), len);
}

uint8_t     netClients() { return static_cast<uint8_t>(g_ws.connectedClients()); }
const char* netIp()      { return g_ip; }
const char* netMode()    { return g_sta ? "sta" : "ap"; }
